## main/Kconfig.projbuild
```kconfig
menu "Set Power Service Configuration"

    menu "WiFi Configuration"
        config WIFI_SSID
            string "WiFi SSID"
            default "your_wifi_ssid"
            help
                SSID (network name) for the example to connect to.

        config WIFI_PASSWORD
            string "WiFi Password"
            default "your_wifi_password"
            help
                WiFi password (WPA or WPA2) for the example to use.
    endmenu

    menu "User Authentication"
        config USER_EMAIL
            string "User Email"
            default "your_email@example.com"
            help
                Email address for authentication with MIC POWER API.

        config USER_PASSWORD
            string "User Password"
            default "your_password"
            help
                Password for authentication with MIC POWER API.
    endmenu

    menu "Device Configuration"
        config DEVICE_SN
            string "Device Serial Number"
            default "TJ000000000000"
            help
                Serial number of the inverter device to control.

        config REQUEST_TIMEOUT_MS
            int "HTTP Request Timeout (ms)"
            default 10000
            range 5000 60000
            help
                Timeout in milliseconds for HTTP requests.

        config MAX_RETRY_COUNT
            int "Maximum Retry Count"
            default 3
            range 1 10
            help
                Maximum number of retries for failed HTTP requests.
    endmenu

    menu "Application Behavior"
        config REQUEST_INTERVAL_SEC
            int "Request Interval (seconds)"
            default 60
            range 10 3600
            help
                Interval in seconds between periodic power setting requests.
    endmenu

endmenu
```
